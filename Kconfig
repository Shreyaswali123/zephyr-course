## Kconfig
```kconfig
# SPDX-License-Identifier: Apache-2.0

rsource "drivers/sensor/led_sensor/Kconfig"
```

## app/Kconfig
```kconfig
mainmenu "Zephyr Application"

source "Kconfig.zephyr"

menu "Application Options"

config APP_HEARTBEAT_PERIOD_MS
    int "Heartbeat LED period (ms)"
    default 500
    range 100 2000
    help
      Controls the delay between heartbeat LED toggles.
      Valid values are from 100 ms to 2000 ms.

endmenu
```

## boards/nxp/frdm_mcxn236_custom/board.yml
```yaml
board:
  name: frdm_mcxn236_custom
  full_name: FRDM-MCXN236
  vendor: nxp
  socs:
  - name: mcxn236
```

## boards/nxp/mcxn236_custom/Kconfig
```kconfig
# SPDX-License-Identifier: Apache-2.0

config BOARD_MCXN236_CUSTOM
    select BOARD_EARLY_INIT_HOOK
```

## boards/nxp/mcxn236_custom/Kconfig.mcxn236_custom
```kconfig
# SPDX-License-Identifier: Apache-2.0

config BOARD_MCXN236_CUSTOM
    select SOC_MCXN236
    select SOC_PART_NUMBER_MCXN236VDF
    select MCUX_OS_TIMER
```

## boards/nxp/mcxn236_custom/board.yml
```yaml
board:
  name: mcxn236_custom
  full_name: MCXN236 Custom Board
  vendor: nxp
  socs:
    - name: mcxn236
```

## drivers/sensor/led_sensor/Kconfig
```kconfig
# SPDX-License-Identifier: Apache-2.0

config LED_SENSOR
    bool "LED sensor driver"
    default y
    depends on GPIO
    depends on SENSOR
    help
      Simple sensor driver using an onboard LED.
```

## dts/bindings/sensor/custom,led-sensor.yaml
```yaml
description: Simple LED sensor driver

compatible: "custom,led-sensor"

properties:
  gpios:
    type: phandle-array
    required: true
    description: GPIO controlling the LED
```

## dts/bindings/sensor/zephyr,led-sensor.yaml
```yaml
description: Simple LED sensor driver

compatible: "zephyr,led-sensor"

properties:
  gpios:
    type: phandle-array
    required: true
    description: GPIO controlling the LED
```
