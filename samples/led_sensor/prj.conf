## CMakeLists.txt
```
cmake_minimum_required(VERSION 3.20.0)

find_package(Zephyr REQUIRED HINTS $ENV{ZEPHYR_BASE})

project(led_sensor)

target_sources(app PRIVATE src/main.c)
```

## prj.conf
```kconfig
CONFIG_GPIO=y
CONFIG_SENSOR=y
CONFIG_LED_SENSOR=y
CONFIG_SERIAL=y
CONFIG_CONSOLE=y
CONFIG_UART_CONSOLE=y
CONFIG_SHELL=y
CONFIG_SHELL_BACKEND_SERIAL=y
```

## src/main.c
```c
#include <zephyr/kernel.h>
#include <zephyr/device.h>
#include <zephyr/drivers/sensor.h>
#include <zephyr/sys/printk.h>
#include <zephyr/shell/shell.h>
#include "led_sensor.h"
#include <stdlib.h>

#define LED_SENSOR_NODE DT_NODELABEL(led_sensor)

#define LED_SENSOR_VALUE_MIN 0
#define LED_SENSOR_VALUE_MAX 100

static const struct device *sensor = DEVICE_DT_GET(LED_SENSOR_NODE);


/* sensor fetch command */
static int cmd_sensor_fetch(const struct shell *shell,
                            size_t argc, char **argv)
{
    ARG_UNUSED(argc);
    ARG_UNUSED(argv);

    int ret = sensor_sample_fetch(sensor);

    if (ret < 0) {
        shell_error(shell, "sensor_sample_fetch() failed: %d", ret);
        return ret;
    }

    shell_print(shell, "sensor_sample_fetch() successful");
    return 0;
}


/* sensor read command */
static int cmd_sensor_read(const struct shell *shell,
                           size_t argc, char **argv)
{
    ARG_UNUSED(argc);
    ARG_UNUSED(argv);

    struct sensor_value value;

    int ret = sensor_channel_get(sensor,
                                 SENSOR_CHAN_LED_STATE,
                                 &value);

    if (ret < 0) {
        shell_error(shell, "sensor_channel_get() failed: %d", ret);
        return ret;
    }

    shell_print(shell, "LED state: %d", value.val1);

    return 0;
}


/* sensor info command */
static int cmd_sensor_info(const struct shell *shell,
                           size_t argc, char **argv)
{
    ARG_UNUSED(argc);
    ARG_UNUSED(argv);

    shell_print(shell, "Device: %s", sensor->name);
    shell_print(shell, "Ready: %s",
                device_is_ready(sensor) ? "YES" : "NO");

    return 0;
}

static int cmd_sensor_set(const struct shell *shell,
                          size_t argc, char **argv);

/* sensor root command */
SHELL_STATIC_SUBCMD_SET_CREATE(sensor_subcmds,
    SHELL_CMD(fetch, NULL, "Fetch sensor sample", cmd_sensor_fetch),
    SHELL_CMD(read, NULL, "Read LED sensor value", cmd_sensor_read),
    SHELL_CMD(info, NULL, "Show sensor information", cmd_sensor_info),
    SHELL_CMD_ARG(set, NULL, "Set sensor value", cmd_sensor_set, 2, 0),
    SHELL_SUBCMD_SET_END
);

SHELL_CMD_REGISTER(sensor, &sensor_subcmds,
                   "LED sensor commands", NULL);
/* sensor set command */
static int cmd_sensor_set(const struct shell *shell,
                          size_t argc, char **argv)
{
    ARG_UNUSED(argc);

    if (argc < 2) {
        shell_error(shell, "Missing value");
        return -EINVAL;
    }

    char *endptr;
    long value = strtol(argv[1], &endptr, 10);

    if (*endptr != '\0') {
        shell_error(shell, "Invalid value: %s", argv[1]);
        return -EINVAL;
    }

    if (value < LED_SENSOR_VALUE_MIN ||
        value > LED_SENSOR_VALUE_MAX) {
        shell_error(shell,
                    "Value must be between %d and %d",
                    LED_SENSOR_VALUE_MIN,
                    LED_SENSOR_VALUE_MAX);
        return -EINVAL;
    }

    int ret = led_sensor_set_value(sensor, (int)value);

    if (ret < 0) {
        shell_error(shell, "led_sensor_set_value() failed: %d", ret);
        return ret;
    }

    shell_print(shell, "Sensor value set to %ld", value);

    return 0;
}

int main(void)
{
    struct sensor_value value;

    if (!device_is_ready(sensor)) {
        printk("LED sensor not ready\n");
        return 0;
    }

    printk("LED sensor shell test started\n");
    printk("Use: sensor fetch | sensor read | sensor info\n");

    while (1) {
        int ret = sensor_sample_fetch(sensor);

        if (ret < 0) {
            printk("sample_fetch failed: %d\n", ret);
            break;
        }

        printk("sample_fetch: LED ON\n");

        ret = led_sensor_set_value(sensor, 42);

        if (ret < 0) {
            printk("led_sensor_set_value failed: %d\n", ret);
            break;
        }

        printk("custom API: sensor value changed to 42\n");

        k_sleep(K_SECONDS(1));

        ret = sensor_channel_get(sensor,
                                 SENSOR_CHAN_LED_STATE,
                                 &value);

        if (ret < 0) {
            printk("channel_get failed: %d\n", ret);
            break;
        }

        printk("channel_get: LED OFF, value = %d\n",
               value.val1);

        k_sleep(K_SECONDS(1));
    }

    return 0;
}
```
